## Kconfig
```kconfig
#
# For a description of the syntax of this configuration file,
# see Documentation/kbuild/kconfig-language.txt.
#
mainmenu "Linux/$ARCH $KERNELVERSION Kernel Configuration"

config SRCARCH
	string
	option env="SRCARCH"

config HVGA_LCMSIZE_TEST
	bool "enable hvga configration"
	help
	"enable hvga configration"

source "arch/$SRCARCH/Kconfig"
```

## arch/arm/mach-osware/Kconfig
```kconfig
comment "Generic ARM OSware Machine Options"
	depends on ARCH_ARM_OSWARE

config MACH_ARM_OSWARE
	bool
	depends on ARCH_ARM_OSWARE
	default y

config MACH_ARM_OSWARE_CORTEX_AX
	bool "CPU is Cortex A8/A9"
	depends on MACH_ARM_OSWARE && CPU_V7
	default y

config RAM_PHYS
        hex "Physical RAM base address"
	depends on MACH_ARM_OSWARE
        default "0"
        help
          The physical start address of the RAM area.

config ONE_SHOT_TIMER
	bool "Use new one shot virtual timer"
	depends on MACH_ARM_OSWARE
	default no
	select GENERIC_TIME
	select GENERIC_CLOCKEVENTS

config HZ
        int "Tick frequency"
	depends on MACH_ARM_OSWARE && !ONE_SHOT_TIMER
        default "100"
        help
          The frequency of the system tick.
```

## arch/arm/mach-sc/Kconfig
```kconfig
if ARCH_SC

menu "Spreadtrum SoC Type"

config  ARCH_SC8825
	bool "sc8825 series(tiger)"
	select CPU_V7
	select HAVE_SMP
	select ARM_GIC
	select HAVE_SCHED_CLOCK
	select LOCAL_TIMERS if SMP
	select VFP
	select VFPv3
	select NEON
	select GENERIC_TIME
	select CLKSRC_MMIO
	select ARCH_HAS_CPUFREQ
	select NEED_MACH_IO_H

config  ARCH_SCX35
	bool "sc8830 series(shark)"
	select CPU_V7
	select HAVE_SMP
	select ARM_GIC
	select HAVE_SCHED_CLOCK
	select LOCAL_TIMERS if SMP
	select VFP
	select VFPv3
	select NEON
	select GENERIC_TIME
	select CLKSRC_MMIO
	select ARCH_HAS_CPUFREQ
	select NEED_MACH_IO_H

config ARCH_SCX15
	bool "scx15 series(dolphin,depend on ARCH_SCX35)"
	select ARCH_SCX35
	help
	  Support for Spreadtrum scx15(dolphin) based systems.

endmenu


config SC_FPGA
       bool
       default n

menu "Spreadtrum Board Type"

config MACH_SP8825EA
	bool "sp8825ea Phone Board"
	depends on ARCH_SC
	depends on ARCH_SC8825
	default y
	help
	  sp8825 EB board based on SC8825 serial.

config MACH_SP5735EA
	bool "sp5735ea PAD Board"
	depends on ARCH_SC
	depends on ARCH_SCX35
	default n
	help
	  SP5735ea board based on SC8830 serial.

config MACH_SPX35EB
	bool "sp8830eb Phone Board"
	depends on ARCH_SC
	depends on ARCH_SCX35
	default n
	help
	  SPX35EB board based on SC8830 serial.

config MACH_SP8835EB
	bool "sp8835eb Phone Board"
	depends on ARCH_SC
	depends on ARCH_SCX35
	default n
	help
	  SP8835EB board based on SC8830 serial.

config MACH_SPX35EA
	bool "sp8830ea Phone Board"
	depends on ARCH_SC
	depends on ARCH_SCX35
	default n
	help
	  SPX35EA board based on SC8830 serial.

config MACH_SPX35EC
	bool "sp8830ec Phone Board"
	depends on ARCH_SC
	depends on ARCH_SCX35
	default n
	help
	  SPX35EC board based on SC8830 serial.

config MACH_SP8830SSW
	bool "sp8830ssw Phone Board"
	depends on ARCH_SC
	depends on ARCH_SCX35
	default n
	help
	  Samsung SP8830SSW board based on SC8830 serial.

config MACH_SC9620OPENPHONE
	bool "sc9620openphone Board"
	depends on ARCH_SC
	depends on ARCH_SCX35
	default n
	help
	  ssc9620openphone board based on SC8830 serial.

config MACH_SC9620FPGA
        bool "sc9620fpga Board"
        depends on ARCH_SC
        depends on ARCH_SCX35
        default n
        help
          ssc9620fpga board based on SC8830 serial.

config MACH_SP7730EC
	bool "sp7730ec Phone Board"
	depends on ARCH_SC
	depends on ARCH_SCX35
	default n
	help
	  SP7730EC board based on SC8830 serial.

config MACH_SP7730ECTRISIM
	bool "sp7730ectrisim Phone Board"
	depends on ARCH_SC
	depends on ARCH_SCX35
	default n
	help
	  SP7730ECTRISIM board based on SC8830 serial.

config MACH_SPX35FPGA
	bool "sp8830 FPGA Board"
	depends on ARCH_SC
	depends on ARCH_SCX35
        select  SC_FPGA
	default n
	help
	  SPX35 fpga board based on SC8830 serial.

config MACH_SP7735EC
	bool "sp7735ec Phone Board"
	depends on ARCH_SC
	depends on ARCH_SCX35
	default n
	help
	  SP7735EC board based on SC8830 serial.


config MACH_SPX15FPGA
	bool "spx15 FPGA Board"
	depends on ARCH_SC
	depends on ARCH_SCX35
	depends on ARCH_SCX15
	default y
        select  SC_FPGA
	help
	  SPX15 fpga board based on dolphin serial.

config MACH_SP6815GA
	bool "sp6815ga Phone Board"
	depends on ARCH_SC
	depends on ARCH_SCX35
	depends on ARCH_SCX15
	default n
	help
	  SP6815GA board based on dolphin serial.
config MACH_SP7715EA
	bool "sp7715ea Phone Board"
	depends on ARCH_SC
	depends on ARCH_SCX35
	depends on ARCH_SCX15
	default n
	help
	  SP7715EA board based on dolphin serial.

config MACH_SP7715EAOPENPHONE
	bool "sp7715eaopenphone Phone Board"
	depends on ARCH_SC
	depends on ARCH_SCX35
	depends on ARCH_SCX15
	default n
	help
	  SP7715EAOPENPHONE board based on dolphin serial.

config MACH_SP7715GA
	bool "sp7715ga Phone Board"
	depends on ARCH_SC
	depends on ARCH_SCX35
	depends on ARCH_SCX15
	default n
	help
	  SP7715GA board based on dolphin serial.

config MACH_SP8815GA
	bool "sp8815ga Phone Board"
	depends on ARCH_SC
	depends on ARCH_SCX35
	depends on ARCH_SCX15
	default n
	help
	  SP8815GA board based on dolphin serial.

config MACH_SP8815GAOPENPHONE
	bool "sp8815gaopenphone Phone Board"
	depends on ARCH_SC
	depends on ARCH_SCX35
	depends on ARCH_SCX15
	default n
	help
	  SP8815GAOPENPHONE board based on dolphin serial.

config MACH_STAR2
	bool "star2 Phone Board"
	depends on ARCH_SC
	depends on ARCH_SCX35
	depends on ARCH_SCX15
	default n
	help
	  STAR2 board based on dolphin serial.

config MACH_CORSICA_VE
	bool "corsica_ve Phone Board"
	depends on ARCH_SC
	depends on ARCH_SCX35
	depends on ARCH_SCX15
	default n
	help
	  CORSICA_VE board based on dolphin serial.

config MACH_SP8830GA
	bool "sp8830ga Phone Board"
	depends on ARCH_SC
	depends on ARCH_SCX35
	default n
	help
	  SP8830GA board based on SC8830 serial.

config MACH_SP7730GA
	bool "sp7730ga Phone Board"
	depends on ARCH_SC
	depends on ARCH_SCX35
	default n
	help
	  SP7730GA board based on SC8830 serial.

endmenu

config SPRD_ION_SIZE
        int "size for ion"
        range 1 64
        default 1
	depends on ION

config SPRD_ION_OVERLAY_SIZE
        int "size for ion overlay"
        range 1 64
        default 1
	depends on ION

config SC_VIBRATOR
        bool "vibrator for SC serials"
        select ANDROID_TIMED_OUTPUT
        default n

config SC_VIBRATOR_GPIO
        bool "vibrator for SC serials by gpio"
        default n
	depends on SC_VIBRATOR

config EIRQ_NUM
        int "number for external irq region desc request"
        range 0 1024
	default 0

comment "SC8830 ADIE type"

config SC_INTERNAL_ADI
	bool "spreadtrum sc internal adi"
	default y
	depends on ARCH_SCX35

config SC_INTERNAL_ADC
	bool "spreadtrum sc internal adc"
	default y
	depends on ARCH_SCX35

config SC_INTERNAL_WATCHDOG
	bool "spreadtrum sc internal watchdog"
	default y
	depends on ARCH_SCX35

config FIX_V7TAGRAM_BUG
        bool "fix arm-v7 scu tag ram bug"
        default n
	depends on ARCH_SCX35
	depends on SMP

config DDR_VALIDITY_TEST
	bool "test ddr validity before go into ddr"
	default n

config SPRD_CPU_DYNAMIC_HOTPLUG
	bool "cpu dynamic hotplug with DVFS"
	default n
	depends on HOTPLUG_CPU
	depends on ARCH_SCX35

config SPRD_DCDC_DEBUG
	tristate "Enable dcdc debug module"
	default n
	help
	  This option select dcdc debug module.

config SPRD_AVS_DEBUG
	tristate "Enable avs debug module"
	default n
	help
	  This option select avs debug module.

config SPRD_SIMCTRL
	bool "Enable simctrl module"
	default n
	help
	  This option select simctrl module.
config SPRD_MODEM_TD
	bool "SPRD TD modem"
	default n
	help
	  This option select modem type.

config SIPC_TD
	bool "SIPC instance of TD modem"
	select SIPC
	default n

config SIPC_WCDMA
	bool "SIPC instance of WCDMA modem"
	select SIPC
	default n

config SIPC_WCN
	bool "SIPC instance of Wireless Connection"
	select SIPC
	default n

config VOIP_CPT
	bool "VOIP process in modem T,it is processed in modem W by default"
	default n
	depends on SIPC_TD

config BUS_MONITOR
        bool "scxx35 AHB and DMC bus monitors"
        default n
	depends on ARCH_SCX35

config BUS_MONITOR_DEBUG
        bool "debug scxx35 AHB and DMC bus monitors"
        default n
	depends on BUS_MONITOR

config EAR_LOW_LEVEL_DETECT
        bool "ear detecting trigger is low level"
        default n

endif
```

## arch/arm/mach-sc8800g/Kconfig
```kconfig
if ARCH_SC8800G

config ARCH_SUPPORTS_BIG_ENDIAN
	bool
	default y

choice
    prompt "SC8800G Board Type"
	default MACH_OPENPHONE

config MACH_G2PHONE
	depends on ARCH_SC8800G
	bool "G2 PHONE"
	help
	  Support for the SC8800G based G2 phone

config MACH_OPENPHONE
	depends on ARCH_SC8800G
	bool "OpenPhone Board"
	help
	  Support for the SC8800G based openphone

config MACH_SP6810A
	depends on ARCH_SC8800G
	bool "SP6810A Phone"
	help
	  Support for the SP6810A Phone

endchoice

config SC8800G_IDLE
	depends on ARCH_SC8800G
	default n
	bool "Idle Support for SC8800G"

config SC8800G_VIBRATOR
    depends on ARCH_SC8800G
    select ANDROID_TIMED_OUTPUT
    default n
    bool "vibrator for SC8800G"

endif
```

## arch/arm/mach-sc8800s/Kconfig
```kconfig
if ARCH_SC8800S

config ARCH_SUPPORTS_BIG_ENDIAN
	bool
	default y

comment "SC8800S Board Type"
	depends on ARCH_SC8800S

config MACH_HISENSE
	depends on ARCH_SC8800S
	default n
	bool "Hisense Board"
	help
	  Support for the sc8800s based hisense phone
config MACH_BIGPHONE
	depends on ARCH_SC8800S
	default y
	bool "BigPhone Board"
	help
	  Support for the sc8800s based big phone

config SC8800S_IDLE
	depends on ARCH_SC8800S
	default y
	bool "Idle Support for SC8800S"

config CHIP_VER_8800H5
	depends on ARCH_SC8800S
	default y
	bool "chip version select"
endif
```

## arch/arm/mach-sc8810/Kconfig
```kconfig
if ARCH_SC8810

comment "SC8810 Board Type"

choice
	prompt "SC8810 Board"

config MACH_SP8810EA
	default n
	bool "SP8810EA Phone"
	help
	  SP8810EA phone board based on SC8810.

config MACH_SP8810EB
	default n
	bool "SP8810EB Phone"
	help
	  SP8810EB phone board based on SC8810.

config MACH_SP8810GA
	default n
	bool "SP8810GA Phone"
	help
	  SP8810GA phone board based on SC8810.

config MACH_SP6820GA
	default n
	bool "SP6820GA Phone"
	help
	  SP6820GA phone board based on SC8810.

config MACH_AMAZING
	default n
	bool "AMAZING Phone"
	help
	  AMAZING phone board based on SC8810.
endchoice

config SPRD_PMEM_SIZE
        int "size for /dev/pmem"
        range 1 16
        default 8
	depends on ANDROID_PMEM

config SPRD_PMEM_ADSP_SIZE
        int "size for /dev/pmem_adsp"
        range 1 64
        default 22
	depends on ANDROID_PMEM

config SC8810_VIBRATOR
        depends on ARCH_SC8810
        select ANDROID_TIMED_OUTPUT
        default n
        bool "vibrator for SC8810"

endif
```

## arch/arm/mach-sc8825/Kconfig
```kconfig
if ARCH_SC8825

comment "SC8825 Board Type"

choice
	prompt "SC8825 Board"

config MACH_SP8825_FPGA
	default n
	bool "SP8825 FPGA"
	help
	  SP8825 FPGA board based on SC8825.
config MACH_SP8825EA
	default n
	bool "SP8825EA"
	help
	  SP8825 EA based on SC8825.
config MACH_SP8825EB
	default n
	bool "SP8825EB"
	help
	  SP8825 EB based on SC8825.
config MACH_GARDA
	default n
	bool "GARDA"
	help
	  GARDA based on SC8825.
endchoice

config SPRD_PMEM_SIZE
        int "size for /dev/pmem"
        range 1 16
        default 8
	depends on ANDROID_PMEM
config SPRD_PMEM_ADSP_SIZE
        int "size for /dev/pmem_adsp"
        range 1 64
        default 22
	depends on ANDROID_PMEM

config SPRD_ION_SIZE
        int "size for ion"
        range 1 64
        default 1
	depends on ION
config SPRD_ION_OVERLAY_SIZE
        int "size for ion overlay"
        range 1 64
        default 1
	depends on ION

config SC8825_VIBRATOR
        depends on ARCH_SC8825
        select ANDROID_TIMED_OUTPUT
        default n
        bool "vibrator for SC8825"

config SPRD_DCDC_DEBUG
	default y
	tristate "Enable dcdc debug module"
	help
		This option select dcdc debug module.
endif
```

## drivers/cpuidle/Kconfig
```kconfig
config CPU_IDLE
	bool "CPU idle PM support"
	default ACPI
	help
	  CPU idle is a generic framework for supporting software-controlled
	  idle processor power management.  It includes modular cross-platform
	  governors that can be swapped during runtime.

	  If you're using an ACPI-enabled platform, you should say Y here.

config CPU_IDLE_GOV_LADDER
	bool
	depends on CPU_IDLE
	default y

config CPU_IDLE_GOV_MENU
	bool
	depends on CPU_IDLE && NO_HZ
	default y

config CPU_IDLE_SC8800S
	bool "CPUIdle support for Spreadtrum SC8800S CPUs"
	depends on CPU_IDLE && ARCH_SC8800S
	default y

config CPU_IDLE_SC8800G
	bool "CPUIdle support for Spreadtrum SC8800G CPUs"
	depends on CPU_IDLE && ARCH_SC8800G
	default y
```

## drivers/demod/IF228/Kconfig
```kconfig
#
# innofidei cmmb driver configuration
#
#
menuconfig INNOCMMB
        tristate "Innofidei cmmb driver"
	help
	  Innofidei cmmb driver support spi/sdio mode transfer base on IF2xx.

if INNOCMMB
config INNOCMMB_DEBUG
	boolean "Debug support for Innofidei cmmb drivers"
	help
	  Say "yes" to enable debug messaging (like dev_dbg and pr_debug),
	  in innofidei cmmb drivers.

config INNOCMMB_PLAT_DEVKIT8000
        tristate "Devkit8000 board cmmb driver platform layer"
	help
	  If your system is omap2 devkit8000 , you can enable this module, it
          also depend on your hardware design, for example reset pin and spi 
          port you used.

endif
```

## drivers/gpu/ion/Kconfig
```kconfig
menuconfig ION
	tristate "Ion Memory Manager"
	select GENERIC_ALLOCATOR
	help
	  Chose this option to enable the ION Memory Manager.

config ION_PAGECACHE
	bool "Share spare carveout pages as page cache"
	depends on ION
	help
	  Select this to enable spare carveout pages as page cache,
	  when reading in file for a page fault or reading ahead pages for
	  the share executable object.

config ION_BUDDY_CARVEOUT
	bool "use buddy memory management in ion carveout heap "
	depends on ION
	select BUDDY_ALLOCATOR
	help
	  Select this to enable buddy carveout heap

config ION_BUDDY_CHECKPAGE
	bool "Add one more page to check the modified memory"
	depends on BUDDY_ALLOCATOR
	depends on ION_PAGECACHE
	help
	  Choose this option if you wish to slove the memory modified problem.


config ION_TEGRA
	tristate "Ion for Tegra"
	depends on ARCH_TEGRA && ION
	help
	  Choose this option if you wish to use ion on an nVidia Tegra.

config ION_SPRD
	tristate "Ion for SPRD"
	depends on ION
	help
	  Choose this option if you wish to use ion on an SPRD chip.
```

## drivers/gpu/sprd_iommu/Kconfig
```kconfig
config SPRD_IOMMU
	bool "SPRD IOMMU Module"
	select ARM_HAS_SG_CHAIN
	help
	  Chose this option to enable the SPRD IOMMU.
```
