## drivers/i2c/chips/Kconfig
```kconfig
#
# Miscellaneous I2C chip drivers configuration
#
# *** DEPRECATED! Do not add new entries! See Makefile ***
#

menu "Miscellaneous I2C Chip support"

config DS1682
	tristate "Dallas DS1682 Total Elapsed Time Recorder with Alarm"
	depends on EXPERIMENTAL
	help
	  If you say yes here you get support for Dallas Semiconductor
	  DS1682 Total Elapsed Time Recorder.

	  This driver can also be built as a module.  If so, the module
	  will be called ds1682.

config SENSORS_TSL2550
	tristate "Taos TSL2550 ambient light sensor"
	depends on EXPERIMENTAL
	help
	  If you say yes here you get support for the Taos TSL2550
	  ambient light sensor.

	  This driver can also be built as a module.  If so, the module
	  will be called tsl2550.

config SENSORS_PCA963X
	tristate "Philips PCA963X 4-bit I2C-bus LED"
	depends on I2C && EXPERIMENTAL
	help
	 If you say yes here you get support for the Philips PCA963X
	 4-bit I2C-bus LED.

	 This driver can also be built as a module.  If so, the module
	 will be called pca963X.

config SENSORS_MXC622X
    tristate "MEMSIC Accelerometer Sensor MXC622X Driver Support"
    depends on I2C
    help
     If you say yes here you get support for the MEMSIC accelerometer sensor

config SENSORS_MMC31XX
    tristate "MEMSIC Magnetic Sensor MMC31XX Driver Support"
    depends on I2C
    help
    If you say yes here you get support for the MEMSIC magnateic sensor

config ECOMPASS
   tristate "MEMSIC eCompass Driver Support"
   depends on I2C
   help
    If you say yes here you get support for the MEMSIC eCompass

endmenu
```

## drivers/media/mdtv/Kconfig
```kconfig
#
# MDTV device configuration, siano, innofidei ..
#

source "drivers/media/mdtv/maxscend/Kconfig"
source "drivers/media/mdtv/siano/Kconfig"
```

## drivers/media/radio/trout_fm/Kconfig
```kconfig
config RADIO_TROUT_FM
	tristate "Trout FM radio support"
       default n
	help
	  Say Y here if you want support for Trout FM Radio receiver
```

## drivers/media/video/sprd_dcam/Kconfig
```kconfig
if VIDEO_DCAM_SPRD
choice
	prompt "Camera resolution"
	default CAMERA_5M

config CAMERA_2M
	bool "2M pixels"

config CAMERA_3M
	bool "3M pixels"

config CAMERA_5M
	bool "5M pixels"

config CAMERA_8M
	bool "8M pixels"

endchoice

choice
	prompt "Camera rotation"
	default CAMERA_NO_ROTATION

config CAMERA_ROTATION
	bool "sensor rotation"

config CAMERA_NO_ROTATION
	bool "sensor don't rotate"

endchoice

config SENSOR_DRIVER_FOR_ANDROID2
	tristate "android version"
	help
	  select - sensor driver is used to android2.2.2.
endif
```

## drivers/misc/gpsip/Kconfig
```kconfig
#
# CGX GPS subsystem configuration
#
menu "GPS modules"
config CGX
	bool "Sprd gps"
	default n
	help
	  GPS can locate you position

config CGX_DRIVER
	tristate "Sprd gps driver"
	depends on CGX
	help
	  GPS can locate you position

config CGX_VIRTUALCOM
	tristate "Sprd gps virtual com"
	depends on CGX
	help
	  GPS can locate you position
endmenu
```

## drivers/misc/sdiodev/Kconfig
```kconfig
menu "SDIODEV modules"

config SDIODEV
	tristate "SPRD SDIO DEV SUPPORT"	
	---help---
	  PLEASE INSMOD THIS MODULE BEFORE OTHER SDIO DEV MODULES

config SDIODEV_TEST
	bool "SDIO DEV TEST"
	default n
	depends on SDIODEV
	help
	  FOR RUN SDIODEV TEST CASE,DO NOT OPEN IT IN NORMAL MODE

config SP9630EA6MN_SDIODEV
	bool "SP9630-6 SDIO"
	default n
	help
	  FOR SP9630-6 SDIO

endmenu
```

## drivers/misc/sprd_2351/Kconfig
```kconfig
config SPRD_2351
	bool "SPRD RF 2351 Driver"
	default n
	help
	  If you say yes here you can use the sprd 2351 rf.
```

## drivers/misc/sprd_blc/Kconfig
```kconfig
# to add sprd jpg configs in the future
config SPRD_BLC
	tristate "SPRD Breathing Light Contoller"
	depends on ARCH_SCX35
	default y
```

## drivers/misc/sprd_busmonitor/Kconfig
```kconfig
# to add sprd busmonitor configs
config SPRD_BUSMONITOR_CORE
	tristate "SPRD BusMonitor Core"
	depends on ARCH_SC8825
	default n

config SPRD_BUSMONITOR
	tristate "SPRD BusMonitor Low Level Driver"
	depends on ARCH_SC8825 || ARCH_SC8830
	default n
	
```

## drivers/misc/sprd_jpg/Kconfig
```kconfig
# to add sprd jpg configs in the future
config SPRD_JPG
	tristate "SPRD jpg driver"
	depends on ARCH_SC8830
	default y
```

## drivers/net/wireless/ittiam/Kconfig
```kconfig
config ITTIAM
	tristate "SPRD Wireless Network Support"
	depends on CFG80211 && SIPC
	---help---
	  Say Y to enable built-in wireless MAC controller in the
	  Spreadtrum SC88xx based System-on-Chip devices.

config ITM_WLAN_FW_ZEROCOPY
	depends on ITTIAM
	bool "Enable WLAN zerocopy"
	default n
	help
	  Say Y to enable WLAN zerocopy.

if ITTIAM
choice
	prompt "SPRD WLAN sleep policy"
	default ITM_WLAN_PM_IRRELEVANT

config ITM_WLAN_PM_IRRELEVANT
	depends on ITTIAM && PM
	bool "Irrelevant sleep policy"
	help
	  The WLAN power management is took care by firmware.

config ITM_WLAN_PM_POWERSAVE
	depends on ITTIAM && PM
	bool "Traditional sleep policy"
	help
	  The WLAN power management is took care by system.

endchoice

config ITM_WIFI_DIRECT
	depends on ITTIAM && PM
	bool "WiFi Direct"
	help
	  Connect to wifi direct device.
endif
```

## drivers/net/wireless/trout/Kconfig
```kconfig
menu "TROUT WLAN MAC support"
config TROUT
	tristate "TROUT Wireless MAC driver"
	---help---
		Enable TROUT WLAN MAC driver within the kernel.

config TROUT_WEXT
    bool "Enable WEXT support"
	depends on TROUT && CFG80211 = n
	select WIRELESS_EXT
	select WEXT_PRIV
	---help---
		Enables WEXT support
endmenu
```

## drivers/net/wireless/trout/mac/build/Kconfig
```kconfig
menu "Ittiam WLAN MAC support"
#	depends NETDEVICES

config ITTIAM_MAC
	tristate "Ittiam Wireless MAC driver"
	---help---
		Enable Ittiam WLAN MAC driver within the kernel. 

if ITTIAM_MAC = y

comment "Operating Mode (Select any One)" 
	depends on ITTIAM_MAC

config ITTIAM_AP
	depends on ITTIAM_MAC  
	bool "Access Point Mode"
	default n
	---help---
		Enable Access point mode of operation.

config ITTIAM_STA
	depends on ITTIAM_MAC 
	bool "Station Mode"
	default n
	---help---
		Enable Station mode of operation.

config ITTIAM_DUT
	depends on ITTIAM_MAC 
	bool "MAC Hardware Unit Test Mode"
	default n
	---help---
		Enable MDUT mode of operation.

comment "MAC Protocols" 
	depends on ITTIAM_MAC

config ITTIAM_11E
	depends on ITTIAM_MAC
	bool "Enable 802.11e QoS support"
	default n
	---help---
		Enable 801.11e QoS support.

config ITTIAM_11I
	depends on ITTIAM_MAC
	bool "Enable 802.11i Security"
	default n
	---help---
		Enable 802.11i Security.

config ITTIAM_1X
	depends on ITTIAM_11I
	bool "Enable 802.1x Authentication"
	default n
	---help---
		Enable 802.1x Authentication support.

config ITTIAM_11N
	depends on ITTIAM_MAC
	bool "Enable 802.11n HT support"
	default n
	---help---
		Enable 802.11n MAC features. This option requires 802.11e and 802.11i options to be enabled. 
		This also requires 802.11n PHY to be enabled.

comment "Host Interface (Select any One)" 
	depends on ITTIAM_MAC

config ITTIAM_ETH_HOST
	depends on ITTIAM_MAC
	bool "Ethernet Host Interface"
	default n
	---help---
		Enable Ethernet Host Interface.

endif 

endmenu
```
