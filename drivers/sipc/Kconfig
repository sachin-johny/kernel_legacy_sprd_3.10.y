## drivers/sipc/Kconfig
```kconfig
menu "SIPC modules"

config SIPC
	bool "Sprd IPC"
	default n
	help
	  SIPC is a module for spreadtrum AP/CP communicaiton system.

config SIPC_SPIPE
	bool "sprd pipe driver based on SBUF"
	default n
	depends on SIPC
	help
	  This driver is a pipe driver base on SBUF, which create
	  general pipes between AP & CP.

endmenu
```

## drivers/video/sc8825/Kconfig
```kconfig
config FB_SC8825
	boolean "SC8825 frame buffer support "
	depends on FB && ARCH_SC8825
	select FB_CFB_FILLRECT
	select FB_CFB_COPYAREA
	select FB_CFB_IMAGEBLIT
	help
          Frame buffer driver for sc8825 based boards.

config FB_LCD_HX8369
	boolean "support HX8369 panel"
	depends on FB_SC8825
	default n

config FB_LCD_S6D0139
	boolean "support S6D0139 panel"
	depends on FB_SC8825
	default n
```

## drivers/video/spreadtrum/Kconfig
```kconfig
config FB_SC8810
	boolean "SC8810 frame buffer support "
	depends on FB && ARCH_SC8810
	select FB_CFB_FILLRECT
	select FB_CFB_COPYAREA
	select FB_CFB_IMAGEBLIT
	help
          Frame buffer driver for SC8810 based boards.

config FB_LCD_HX8369
	boolean "support HX8369 panel"
	depends on FB_SC8810
```

## drivers/vlx/Kconfig
```kconfig
#
# Input device configuration
#

if NKERNEL_DDI

menu "VLX virtual device support"

if INPUT_EVDEV

config INPUT_VEVDEV_BE
        tristate "Vevent backend interface"
        default n 
        help
          Say Y here if this OS provides the real input events

          To compile this driver as a module, choose M here: the
          module will be called vevdev-be.

config INPUT_VEVDEV_BE_FOCUS
        bool "Focus switch support in the vevent backend driver"
        depends on INPUT_VEVDEV_BE
        default n 
        help
	  Say Y here if the vevent backend driver manages the focus
	  switch and/or VM restart hot keys.

config INPUT_VEVDEV_FE
        tristate "Vevent frontend interface"
        default n 
        help
          Say Y here if this OS consumes the input events

endif

if FB

config FB_VLCD_BACKEND
        tristate "Virtual LCD backend driver for VLX based Linux"
        depends on ARM
	default n
        select FB_CFB_FILLRECT
        select FB_CFB_COPYAREA
        select FB_CFB_IMAGEBLIT
        help
         LCD backend driver for Linux running on top of VLX

config FB_VLCD_FRONTEND
        tristate "Virtual LCD frontend driver for VLX based Linux"
        depends on ARM
	default n
        select FB_CFB_FILLRECT
        select FB_CFB_COPYAREA
        select FB_CFB_IMAGEBLIT
        help
         LCD frontend driver for Linux running on top of VLX

endif

if SND

config SND_VAUDIO_BE
        tristate "Vaudio backend interface"
        default n 
        help
          Say Y here if this OS manages sound hardware

          To compile this driver as a module, choose M here: the
          module will be called vaudio-be.

config SND_VAUDIO_FE
        tristate "Vaudio frontend interface"
        default n 
	select SND_PCM
        help
          Say Y here if this OS exports virtual audio interface

          To compile this driver as a module, choose M here: the
          module will be called vaudio-fe.

endif

if WATCHDOG

config VWDT_FRONTEND
        tristate "Virtual watchdog frontend driver for VLX based Linux"
        depends on ARM
        default n 
        help
         Watchdog frontend driver for Linux running on top of VLX

config VWDT_BACKEND
        tristate "Virtual watchdog backend driver for VLX based Linux"
        depends on ARM
        default n 
        help
         Watchdog backend driver for Linux running on top of VLX

endif

config NKERNEL_VETH
        tristate "VLX Virtual Ethernet driver"
        depends on NETDEVICES
        default n 
        help
          VLX virtual Ethernet driver.
          This driver emulates Ethernet communication with a back-end driver
          running in another partition.

          To compile this driver as a module, choose M here: the
          module will be called veth.

config NKERNEL_VETH_RING_SIZE
	int "Number of frame buffers in communication rings"
	default "64"
	depends on NKERNEL_VETH
	help
	  The default number of Ethernet frame buffers in shared memory is
	  64 per direction, resulting in around 200 KB of memory usage per
	  veth link. The same value of this setting must be used by both
	  peer veth drivers. The value must be a power of 2. Note that
	  some versions of the veth driver (which is currently part of
	  the Linux component, rather than of the vdrivers component)
	  might not take this setting into account.

if BLOCK
config VBD_BE
        tristate "Virtual block device backend interface"
        default n
        help
          Virtual Block Device backend
          
          To compile this driver as a module, choose M here: the
          module will be called vlx-vbd-be.

config VBD2_BE
        tristate "Virtual block device v.2 backend interface"
        default n
	select VMQ
        help
          Virtual Block Device v.2 backend

          To compile this driver as a module, choose M here: the
          module will be called vlx-vbd2-be.

config VBD_FE
        tristate "Virtual block device frontend interface"
        default n
        help
          Virtual Block Device frontend
          
          To compile this driver as a module, choose M here: the
          module will be called vlx-vbd-fe.

config VBD2_FE
        tristate "Virtual block device v.2 frontend interface"
        default n
	select VMQ
        help
          Virtual Block Device v.2 frontend

          To compile this driver as a module, choose M here: the
          module will be called vlx-vbd2-fe.
endif

if 0
config VUART_FRONTEND
        tristate "Virtual UART frontend driver for VLX based Linux"
        depends on ARM
        default n
        help
         UART frontend driver for Linux running on top of VLX
endif

config VPIPE
        tristate "Virtual pipe for inter OS communication"
        default n 
        help
          Virtual unidirectional pipe for inter OS communication.

          To compile this driver as a module, choose M here: the
          module will be called vpipe.

config VUPIPE
        tristate "Virtual user land pipe for inter OS communication"
        default n 
        help
          Virtual unidirectional pipe for inter OS communication.
	  An application uses mmap to see the pipe buffer from
	  the user land, so this is zero-copy communication device.

          To compile this driver as a module, choose M here: the
          module will be called vupipe.

config VBPIPE
        tristate "Virtual bidirectional pipe for inter OS communication"
        default n 
        help
          Virtual bidirectional pipe for inter OS communication.

          To compile this driver as a module, choose M here: the
          module will be called vbpipe.

config VMQ
	tristate "Virtual Messages Queues inter-guest communication module"
	default n

if MTD

config VMTD_BE
        tristate "Virtual Memory Technology Device backend interface"
        default m
	select VMQ
        help
          Virtual Memory Technology Device backend
          
          To compile this driver as a module, choose M here: the
          module will be called vmtd-be.

config VMTD_FE
        tristate "Virtual Memory Technology Device frontend interface"
        default m
	select VMQ
        help
          Virtual Memory Technology Device frontend
          
          To compile this driver as a module, choose M here: the
          module will be called vmtd-fe.

endif

config VLX_VRPC
	tristate "Virtual RPC inter-guest communication module"
	default n

config VBATTERY_FRONTEND
        tristate "Virtual battery frontend interface"
        depends on POWER_SUPPLY
        default n
        select VLX_VRPC
        help
          Virtual battery frontend interface

config VBATTERY_BACKEND
        tristate "Virtual battery backend interface"
        depends on POWER_SUPPLY
        default n
        select VLX_VRPC
        help
          Virtual battery backend interface

config VPMEM_FRONTEND
        bool "Virtual Android Physical Memory frontend interface"
        default n
        select ANDROID_PMEM
        help
          Virtual bit Android Physical Memory frontend interface

config VPMEM_BACKEND
        bool "Virtual Android Physical Memory backend interface"
        default n
        help
          Virtual bit Android Physical Memory backend interface

config VBLITTER_FRONTEND
        bool "Virtual blitter frontend interface"
        default n
        select VLX_VRPC
        help
          Virtual bit blitter frontend interface

config VBLITTER_BACKEND
        bool "Virtual blitter backend interface"
        default n
        depends on VPMEM_BACKEND
        select VLX_VRPC
        help
          Virtual bit blitter backend interface

if NKERNEL
config VLX_MONITORING
        tristate "VLX Monitoring Interface"
        default n
        help
          VLX monitoring interface

          To compile this driver as a module, choose M here: the
          module will be called perfmonitor.

endif

config VVIDEO_BE
        tristate "Virtual video backend interface"
        default n 
        help
          Say Y here if this OS manages video hardware

          To compile this driver as a module, choose M here: the
          module will be called vvideo-be.

config VVIDEO_BE_HW
        tristate "Virtual video overlay interface"
        depends on VVIDEO_BE
        default n
        help
          Say Y here if this OS does not feature a hardware
	  video overlay device.

          To compile this driver as a module, choose M here: the
          module will be called vvideo-be-hw.

config VVIDEO_FE
        tristate "Virtual video frontend interface"
        default n 
        help
          Say Y here if this OS exports virtual video interface

          To compile this driver as a module, choose M here: the
          module will be called vvideo-fe.

config VRTC_FE
	tristate "Virtual Real Time Clock frontend interface"
	select RTC_CLASS
	select VLX_VRPC
	default n
	help
	  To compile this driver as a module, choose M here: the
	  module will be called vrtc-fe.

config VRTC_BE
	tristate "Virtual Real Time Clock backend interface"
	select RTC_CLASS
	select VLX_VRPC
	default n
	help
	  To compile this driver as a module, choose M here: the
	  module will be called vrtc-be.

config VSHM
        tristate "Virtual shared memory interface"
        default n 
        help
          Say Y here if this OS exports virtual shared interface

          To compile this driver as a module, choose M here: the
          module will be called vshm.

config VOGL_FE
	tristate "Virtual OpenGL ES frontend infrastructure"
	default n
	select VRPQ_FE
	help
	  Kernel-level support for the VLX virtual OpenGL ES frontend
          infrastructure. Choose this option if you want to enable the
	  VRPQ and the VGRALLOC frontend drivers.
	  VRPQ (Virtual Remote Procedure Queue) is the VOpenGL ES transport
          layer. It enables user-land components to execute remote procedures
          on a virtualized platform.
          VGRALLOC (Virtual Graphics Memory Allocator) enables to manage
	  the graphics memory on a virtualized platform.

config VOGL_BE
	tristate "Virtual OpenGL ES backend infrastructure"
	default n
	select VRPQ_BE
	help
	  Kernel-level support for the VLX virtual OpenGL ES backend
          infrastructure. Choose this option if you want to enable the
	  VRPQ and the VGRALLOC backend drivers.
	  VRPQ (Virtual Remote Procedure Queue) is the VOpenGL ES transport
          layer. It enables user-land components to execute remote procedures
          on a virtualized platform.
          VGRALLOC (Virtual Graphics Memory Allocator) enables to manage
	  the graphics memory on a virtualized platform.

config VRPQ_FE
	tristate

config VRPQ_BE
	tristate

config VRPQ_PROFILE
        bool "VRPQ (Virtual Remote Procedure Queue) profiling support"
        default n
	depends on VRPQ_FE || VRPQ_BE
        help
          Enable statistics collect in the VRPQ (Virtual Remote Procedure
          Queue) layer.

config XIRQ_BENCH
	tristate "Virtual driver used to benchmark INTER-OS communication"
	default n
	help
	  Benchmark cross-interrupt

config VINFO
        tristate "VLX internal information driver"
        default y
        help
          VLX information driver creates information files in
	  /proc/nk to show internal system information.

          To compile this driver as a module, choose M here: the
          module will be called vinfo.

config VLX_UMP
        tristate "User Mode virtual driver Proxy driver"
        default m
        help
	  Driver providing support for backend drivers in user mode,
	  that is running as processes.

	  To compile this driver as a module, choose M here: the
	  module will be called vlx-ump.

endmenu

endif
```

## fs/proc/sprd_modk/Kconfig
```kconfig
config SPRD_DISPLAY_CPU_FREQ
    bool "sprd display cpu frequency"
    default y
    help
        This option enable display the cpu frequency
```

## sound/soc/sc8810/Kconfig
```kconfig
menu "SoC Audio for the SPREADTRUM SC88XX"

config SND_SC8810_SOC_SPRDPHONE
	tristate "sprdphone -- SoC Audio for the SPREADTRUM SC8810 chips with intergrated VBC Dolphin codec"
    select SND_PCM
    help
      Say Y if you want to built in to kernel, Say M for ko module.

endmenu
```

## sound/soc/sc88xx/Kconfig
```kconfig
menu "SoC Audio for the SPREADTRUM SC88XX"

config SND_SC88XX_SOC_SPRDPHONE
	tristate "sprdphone -- SoC Audio for the SPREADTRUM SC88XX chips with intergrated VBC Dolphin codec"
#   depends on ARCH_SC8800S
    select SND_PCM
    help
      Say Y if you want to built in to kernel, Say M for ko module.

endmenu


config IIS_FOR_TROUT_FM
	tristate
	default n

config SND_FOR_TROUT_FM
	tristate "trout FM connect to I2S and then use sound modules playback"
	select IIS_FOR_TROUT_FM
	depends on !SND_SPRD_SOC_IIS_FM
	default n

config SND_SPRD_SOC_IIS_FM
	select SND_SPRD_SOC_I2S
	select SND_SOC_NULL_CODEC
	tristate "iis-fm  -- ASoC Audio card for iis-external FM"
	default y
	help
		Say Y if your FM is master i2s and use i2s record pcm wave.

config SPRD_IIS_DEBUG
	bool "iis-fm debug option"
	default y

source "sound/soc/sc88xx/dai/i2s/Kconfig"
source "sound/soc/sc88xx/codec/null-codec/Kconfig"
```
