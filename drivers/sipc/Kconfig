## sound/soc/sprd/Kconfig
```kconfig
menu "SoC Audio for the SPREADTRUM"
config SND_SPRD_SOC_SC881X
	tristate "SC881X phone"
	select SND_ARM
	select SND_SPRD_SOC_VBC
	select SND_SPRD_SOC_AUDIO_DMA
	select SND_SOC_DOLPHIN
	help
	  Say Y if you want to built in to kernel, Say M for ko module.
	  SoC Audio for the SPREADTRUM SC881X chips with intergrated Dolphin codec
	  use VBC and  Dolphin for the audio system.

config SND_SPRD_SOC_SC882X
	tristate "SC882X phone"
	select SND_ARM
	select SND_SPRD_SOC_VBC
	select SND_SPRD_SOC_AUDIO_DMA
	select SND_SOC_SPRD_CODEC
	help
	  Say Y if you want to built in to kernel, Say M for ko module.
	  SoC Audio for the SPREADTRUM SC882X chips with intergrated sprd codec
	  use VBC and  SPRD CODEC for the audio system.

config SND_SPRD_SOC_SCX35
	tristate "SC883X phone"
	select SND_ARM
	select SND_SPRD_SOC_VBC_R2P0
	select SND_SPRD_SOC_AUDIO_DMA
	select SND_SOC_SPRD_CODEC_V3
	help
	  Say Y if you want to built in to kernel, Say M for ko module.
	  SoC Audio for the SPREADTRUM SC8830 chips with intergrated sprd codec
	  use VBC and  SPRD CODEC V3 for the audio system.

config SND_SPEAKER_PA
	tristate "speaker-pa"
	default y

config SPRD_AUDIO_DEBUG
	bool "sprd audio debug"
	default y
	help
          Say Y if defined this will print debug information for detail.

source "sound/soc/sprd/dai/Kconfig"
source "sound/soc/sprd/dai/vbc/Kconfig"
source "sound/soc/sprd/dai/vaudio/Kconfig"
source "sound/soc/sprd/dai/i2s/Kconfig"
source "sound/soc/sprd/codec/dolphin/Kconfig"
source "sound/soc/sprd/codec/sprd/Kconfig"
source "sound/soc/sprd/codec/null-codec/Kconfig"

config SPRD_CODEC_USE_INT
	depends on SND_SOC_SPRD_CODEC||SND_SOC_SPRD_CODEC_V3
	bool "sprd codec use INT"
	default y
	help
          Say Y if defined this will cause sprd codec audio driver use INT
           for hp pop ramp up and ramp down,
           or dac mute wait and dac unmute wait if define CODEC_DAC_MUTE_WAIT.

config CODEC_DAC_MUTE_WAIT
	bool "codec dac mute wait"
	default n
	help
	 Say Y if you want the CODEC dac mute really mute stream data.
         maybe casue dac mute wait sometime until it goto valid.

config CODEC_NO_HP_POP
	bool "codec no hp pop"
	default n
	help
	 Say Y if you want *NOT* the CODEC do hp pop ramp up/down process.
	  some customer use the external hp amplifier will need this feature,
	  or will cause hp pop noise serious.

config HP_POP_DELAY_TIME
	int "hp switch delay time(0-1000) unit(MS)"
	depends on CODEC_NO_HP_POP
	range 0 1000
	default 350
	help
	  if defined CODEC_NO_HP_POP , maybe need this delay
	  for reduce external hp amp noise.
	  this delay time value, unit is MS.

config SPRD_AUDIO_BUFFER_USE_IRAM
	bool "use IRAM when sound playback"
	default n
	help
	  Say Y if you want use IRAM replacment RAM when playback.
	   sometimes, use IRAM maybe reduce power consumption.
           but, it will cause system more busy, becuase the buffer smaller.

config SPRD_AUDIO_USE_INTER_HP_PA
	bool "use spreadtrum internal headphone pa"
	default n
	help
	  Say Y if you want use sprdtrume internal headphone pa

config SND_SPRD_SOC_BT_I2S
	tristate "bt-i2s"
	select SND_SPRD_SOC_I2S
	select SND_SPRD_SOC_AUDIO_DMA
	select SND_SOC_NULL_CODEC
	help
	  Say Y if you want to built in to kernel, Say M for ko module.
	   this option will build spreadtrum I2S driver for external codec
           or like BT/Digital FM etc.

config CODEC_SRC_SAMPLE_RATE
	int "codec src sample rate setting (32000 or 48000) unit(HZ)"
	range 32000 48000
	default 32000
	help
	  when capture sample rate is 44100HZ, we cann't set 44100 HZ for CODEC adc sample rate,
	  so need to set CODEC sample to 32000/48000, then open VBC SRC changing to 44100HZ..

endmenu
```

## sound/soc/sprd/codec/sprd/Kconfig
```kconfig
config SND_SOC_SPRD_CODEC
	tristate # "Sprd-codec-r0p0"
	help
	 this is sprd codec likely the Tiger project.

config SND_SOC_SPRD_CODEC_V2
	tristate # "Sprd-codec-r2p0"
	help
	depends on !SND_SOC_SPRD_CODEC
	 this is sprd codec v2 likely the SC7710/Shark project.

config SPRD_CODEC_EAR_WITH_IN_SPK
	bool "ear with in speaker"
	default n
	help
	 Say Y if your device is use ear&spk in one,
	  and ear have TDD noise when call mode.
	  this feature will open the PA_SW_EN when using ear path.

config SPRD_AUDIO_HOLD_HP_DRIVER
	bool "hold headphone driver on"
	default y
	help
	 Say Y if you want hold headphone dirver on,
	  hold headphone driver always on when exist headphone
          and screen on, smartauto trun off headphone driver
          when screen off.
```

## sound/soc/sprd/codec/sprd/v3/Kconfig
```kconfig
config SND_SOC_SPRD_CODEC_V3
	tristate # "Sprd-codec-v3"

config SND_SOC_SPRD_AUDIO_USE_INTER_HP_PA
	depends on SND_SOC_SPRD_CODEC_V3
	bool "Use spreadtrum internal HeadPhone PA"
	help
	  Say Y if you want use sprdtrume internal headphone pa

config SND_SOC_SPRD_AUDIO_USE_INTER_HP_PA_V2
	depends on SND_SOC_SPRD_AUDIO_USE_INTER_HP_PA
	bool "use spreadtrum internal headphone pa for version 2"
	help
	  Say Y if you want use sprdtrume internal headphone pa for version2

config SND_SOC_SPRD_AUDIO_HP_PA_MUTE_DELAY_TIME
	int "hp pa delay time(0-500) unit(MS)"
	depends on SND_SOC_SPRD_AUDIO_USE_INTER_HP_PA
	range 0 500
	default 100
	help
	  if defined SND_SOC_SPRD_AUDIO_USE_INTER_HP_PA , maybe need this delay
	  for reduce external hp amp noise.
	  this delay time value, unit is MS.
```

## sound/soc/sprd/dai/Kconfig
```kconfig
config SND_SPRD_SOC_AUDIO_DMA
	tristate
	help
	 use this for dma likely sc8810/sc8825/sc8830
```

## sound/soc/sprd/dai/vbc/Kconfig
```kconfig
menu "VBC"

source "sound/soc/sprd/dai/vbc/r1p0/Kconfig"
source "sound/soc/sprd/dai/vbc/r2p0/Kconfig"

config SND_SOC_SPRD_VBC_LR_INVERT
	bool "VBC Support L/R invert"
	help
	 say Y then the VBC will support invert the L/R channel.

config SND_SOC_FM_SAMPLE_RATE_SETTING
	bool "FM Sample Rate Setting in VBC"
	help
	  say Y then the VBC will set codec sample rate for FM  function.

endmenu
```
